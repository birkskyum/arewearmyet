// SPDX-License-Identifier: BSD-3-Clause
/*
 * HP OmniBook X 14 (14-kr0xxx) and OmniBook X 16 (16-cp0xxx), the 2025
 * models with the Snapdragon X Plus X1P-42-100 (Purwa) on board 8F45.
 *
 * Both sizes share board 8F45, HP's driver pack sp172628 and one BIOS
 * (Insyde F.03). The DSDT in that BIOS matches the OmniBook 5 14-he0's
 * (board 8E33) in every device resource, every PEP power vote and every
 * wake interrupt: the keyboard on I2C1 at 0x3a (TLMM 67), the touchpad on
 * I2C3 at 0x15 (TLMM 3), the touchscreen on I2C9 at 0x10 or 0x5d (TLMM
 * 51), the lid on TLMM 92, Wi-Fi on PCIe 4, NVMe on PCIe 6a, the USB
 * controllers and their repeater resets, the sound pins and the eDP power
 * sequence. Its panel list holds the same four Samsung OLED panels, and
 * HP's ADSP driver binds on both boards (SUBSYS_8F45103C and
 * SUBSYS_8E33103C). So the boards start from the OmniBook 5's tree.
 *
 * GpioInt pins of 0x100 and up are virtual: pin 0x100 + 0x40 * k is the
 * k-th interrupt after the four summary interrupts in GIO0._CRS, which
 * qcom,pdc-ranges and the X1 PDC map turn into TLMM pins. This gives
 * 0x180 TLMM 67 (keyboard), 0x3C0 TLMM 3 (touchpad), 0x340 TLMM 92 (lid)
 * and 0x240 TLMM 148, 0x2C0 TLMM 154 (PCIe 4 and 6a wake), the pins the
 * OmniBook 5 tree uses.
 *
 * The DSDT tells the two sizes apart only through values the firmware
 * fills in at boot (SPID for the touchpad model and the thermal limits,
 * SKID for the touchscreen, PLID for the panel), none of which changes a
 * node here.
 */

#include "x1p42100-hp-omnibook-5.dts"

/*
 * HP-signed images from sp172628 (qcdx8380, qcsubsys_ext_adsp8380,
 * qcnspmcdm_ext_cdsp8380).
 */
&gpu_zap_shader {
	firmware-name = "qcom/x1p42100/hp/omnibook-x16-cp0/qcdxkmsucpurwa.mbn";
};

&remoteproc_adsp {
	firmware-name = "qcom/x1p42100/hp/omnibook-x16-cp0/qcadsp8380.mbn",
			"qcom/x1p42100/hp/omnibook-x16-cp0/adsp_dtbs.elf";
};

&remoteproc_cdsp {
	firmware-name = "qcom/x1p42100/hp/omnibook-x16-cp0/qccdsp8380.mbn",
			"qcom/x1p42100/hp/omnibook-x16-cp0/cdsp_dtbs.elf";
};
